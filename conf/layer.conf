## conf/layer.conf
```bitbake
# SPDX-License-Identifier: MIT

# We have a conf and classes directory, append to BBPATH
BBPATH .= ":${LAYERDIR}"

BBFILE_COLLECTIONS += "cyclonedx"
BBFILE_PATTERN_cyclonedx = "^${LAYERDIR}/"

# This layer does not contain any .bb file, only a .bbclass.
BBFILE_PATTERN_IGNORE_EMPTY_cyclonedx = "1"

LAYERDEPENDS_cyclonedx = "core"

# this should be compatible with styhead and later versions (i.e. wrynose)
# not adding the versions between styhead and wrynose as they're already EOL
# for scarthgap or kirkstone use dedicated branches
LAYERSERIES_COMPAT_cyclonedx = "wrynose"
```
